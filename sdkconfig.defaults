## sdkconfig.defaults
```kconfig
PROJECT_VER=1
CONFIG_LWIP_TCPIP_CORE_LOCKING=y
CONFIG_MBEDTLS_ASYMMETRIC_CONTENT_LEN=y
CONFIG_MBEDTLS_SSL_IN_CONTENT_LEN=8192
# CONFIG_MBEDTLS_SSL_OUT_CONTENT_LEN is not set (default 4096)
CONFIG_MBEDTLS_SSL_MAX_CONTENT_LEN=8192
CONFIG_MBEDTLS_SSL_VARIABLE_BUFFER_LENGTH=y
CONFIG_MBEDTLS_HAVE_TIME=y
CONFIG_IDF_EXPERIMENTAL_FEATURES=y

CONFIG_AUTOSTART_ARDUINO=y
# CONFIG_WS2812_LED_ENABLE is not set
CONFIG_FREERTOS_HZ=1000
CONFIG_MBEDTLS_PSK_MODES=y
CONFIG_MBEDTLS_KEY_EXCHANGE_PSK=y
```
